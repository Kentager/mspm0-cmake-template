/**
 * @cliArgs --board "/ti/boards/LP_MSPM0G3507" --product "mspm0_sdk@2.10.00.04"
 * @versions {"tool":"1.27.1+4634"}
 */
scripting.excludeFromBuild("device_linker.cmd");
scripting.excludeFromBuild("device_linker.lds");
scripting.excludeFromBuild("device.opt");
scripting.excludeFromBuild("device.cmd.genlibs");
scripting.excludeFromBuild("device.lds.genlibs");
scripting.excludeFromBuild("Event.dot");

/**
 * Import the modules used in this configuration.
 */
const Board         = scripting.addModule("/ti/driverlib/Board");
const GPIO          = scripting.addModule("/ti/driverlib/GPIO", {}, false);
const GPIO1         = GPIO.addInstance();
const GPIO2         = GPIO.addInstance();
const GPIO3         = GPIO.addInstance();
const GPIO4         = GPIO.addInstance();
const GPIO5         = GPIO.addInstance();
const I2C           = scripting.addModule("/ti/driverlib/I2C", {}, false);
const I2C1          = I2C.addInstance();
const I2C2          = I2C.addInstance();
const PWM           = scripting.addModule("/ti/driverlib/PWM", {}, false);
const PWM1          = PWM.addInstance();
const SYSCTL        = scripting.addModule("/ti/driverlib/SYSCTL");
const UART          = scripting.addModule("/ti/driverlib/UART", {}, false);
const UART1         = UART.addInstance();
const UART2         = UART.addInstance();
const ProjectConfig = scripting.addModule("/ti/project_config/ProjectConfig");

/**
 * Write custom configuration values to the imported modules.
 */
const divider9       = system.clockTree["UDIV"];
divider9.divideValue = 2;

const gate7  = system.clockTree["MFCLKGATE"];
gate7.enable = true;

const gate8  = system.clockTree["MFPCLKGATE"];
gate8.enable = true;

const multiplier2         = system.clockTree["PLL_QDIV"];
multiplier2.multiplyValue = 4;

const mux8       = system.clockTree["HSCLKMUX"];
mux8.inputSelect = "HSCLKMUX_SYSPLL0";

Board.peripheral.$assign          = "DEBUGSS";
Board.peripheral.swclkPin.$assign = "j25_expansion.16";
Board.peripheral.swdioPin.$assign = "j25_expansion.14";

GPIO1.$name                         = "LED";
GPIO1.port                          = "PORTB";
GPIO1.associatedPins.create(2);
GPIO1.associatedPins[0].assignedPin = "2";
GPIO1.associatedPins[0].$name       = "PIN";
GPIO1.associatedPins[1].assignedPin = "3";
GPIO1.associatedPins[1].$name       = "LEF";

GPIO2.$name                          = "IN";
GPIO2.associatedPins.create(4);
GPIO2.associatedPins[0].assignedPort = "PORTA";
GPIO2.associatedPins[0].assignedPin  = "31";
GPIO2.associatedPins[0].$name        = "LEFT_IN1";
GPIO2.associatedPins[1].assignedPort = "PORTA";
GPIO2.associatedPins[1].assignedPin  = "28";
GPIO2.associatedPins[1].$name        = "LEFT_IN2";
GPIO2.associatedPins[2].$name        = "RIGHT_IN1";
GPIO2.associatedPins[2].assignedPort = "PORTA";
GPIO2.associatedPins[2].assignedPin  = "9";
GPIO2.associatedPins[3].$name        = "RIGHT_IN2";
GPIO2.associatedPins[3].assignedPort = "PORTA";
GPIO2.associatedPins[3].assignedPin  = "8";

GPIO3.$name                         = "ENC";
GPIO3.associatedPins.create(4);
GPIO3.associatedPins[0].$name       = "LEFT_ENA";
GPIO3.associatedPins[0].direction   = "INPUT";
GPIO3.associatedPins[0].interruptEn = true;
GPIO3.associatedPins[0].polarity    = "RISE_FALL";
GPIO3.associatedPins[0].pin.$assign = "j17_expansion.1";
GPIO3.associatedPins[1].$name       = "LEFT_ENB";
GPIO3.associatedPins[1].direction   = "INPUT";
GPIO3.associatedPins[1].interruptEn = true;
GPIO3.associatedPins[1].polarity    = "RISE_FALL";
GPIO3.associatedPins[1].pin.$assign = "j17_expansion.6";
GPIO3.associatedPins[2].$name       = "RIGHT_ENA";
GPIO3.associatedPins[2].direction   = "INPUT";
GPIO3.associatedPins[2].interruptEn = true;
GPIO3.associatedPins[2].polarity    = "RISE_FALL";
GPIO3.associatedPins[2].pin.$assign = "boosterpack.13";
GPIO3.associatedPins[3].$name       = "RIGHT_ENB";
GPIO3.associatedPins[3].direction   = "INPUT";
GPIO3.associatedPins[3].interruptEn = true;
GPIO3.associatedPins[3].polarity    = "RISE_FALL";
GPIO3.associatedPins[3].pin.$assign = "boosterpack.14";

GPIO4.$name                               = "KEY";
GPIO4.associatedPins.create(4);
GPIO4.associatedPins[0].direction         = "INPUT";
GPIO4.associatedPins[0].interruptEn       = true;
GPIO4.associatedPins[0].interruptPriority = "2";
GPIO4.associatedPins[0].polarity          = "FALL";
GPIO4.associatedPins[0].internalResistor  = "PULL_UP";
GPIO4.associatedPins[0].$name             = "KEY_0";
GPIO4.associatedPins[0].assignedPort      = "PORTA";
GPIO4.associatedPins[0].assignedPin       = "15";
GPIO4.associatedPins[1].direction         = "INPUT";
GPIO4.associatedPins[1].interruptEn       = true;
GPIO4.associatedPins[1].interruptPriority = "2";
GPIO4.associatedPins[1].polarity          = "FALL";
GPIO4.associatedPins[1].$name             = "KEY_1";
GPIO4.associatedPins[1].internalResistor  = "PULL_UP";
GPIO4.associatedPins[1].assignedPort      = "PORTA";
GPIO4.associatedPins[1].assignedPin       = "12";
GPIO4.associatedPins[2].direction         = "INPUT";
GPIO4.associatedPins[2].interruptEn       = true;
GPIO4.associatedPins[2].interruptPriority = "2";
GPIO4.associatedPins[2].polarity          = "FALL";
GPIO4.associatedPins[2].$name             = "KEY_2";
GPIO4.associatedPins[2].internalResistor  = "PULL_UP";
GPIO4.associatedPins[2].assignedPort      = "PORTB";
GPIO4.associatedPins[2].assignedPin       = "9";
GPIO4.associatedPins[3].direction         = "INPUT";
GPIO4.associatedPins[3].interruptEn       = true;
GPIO4.associatedPins[3].interruptPriority = "2";
GPIO4.associatedPins[3].polarity          = "FALL";
GPIO4.associatedPins[3].$name             = "KEY_3";
GPIO4.associatedPins[3].internalResistor  = "PULL_UP";
GPIO4.associatedPins[3].assignedPort      = "PORTB";
GPIO4.associatedPins[3].assignedPin       = "8";

GPIO5.$name                          = "GrayS";
GPIO5.associatedPins.create(4);
GPIO5.associatedPins[0].$name        = "PIN_3";
GPIO5.associatedPins[0].assignedPort = "PORTA";
GPIO5.associatedPins[0].assignedPin  = "24";
GPIO5.associatedPins[0].direction    = "INPUT";
GPIO5.associatedPins[1].$name        = "PIN_0";
GPIO5.associatedPins[1].assignedPort = "PORTA";
GPIO5.associatedPins[1].assignedPin  = "25";
GPIO5.associatedPins[2].$name        = "PIN_1";
GPIO5.associatedPins[2].assignedPort = "PORTA";
GPIO5.associatedPins[2].assignedPin  = "26";
GPIO5.associatedPins[3].$name        = "PIN_2";
GPIO5.associatedPins[3].assignedPort = "PORTA";
GPIO5.associatedPins[3].assignedPin  = "27";

I2C1.$name                             = "I2C_1";
I2C1.basicEnableController             = true;
I2C1.peripheral.$assign                = "I2C1";
I2C1.peripheral.sdaPin.$assign         = "boosterpack.29";
I2C1.peripheral.sclPin.$assign         = "boosterpack.28";
I2C1.sdaPinConfig.hideOutputInversion  = scripting.forceWrite(false);
I2C1.sdaPinConfig.onlyInternalResistor = scripting.forceWrite(false);
I2C1.sdaPinConfig.passedPeripheralType = scripting.forceWrite("Digital");
I2C1.sdaPinConfig.$name                = "ti_driverlib_gpio_GPIOPinGeneric2";
I2C1.sclPinConfig.hideOutputInversion  = scripting.forceWrite(false);
I2C1.sclPinConfig.onlyInternalResistor = scripting.forceWrite(false);
I2C1.sclPinConfig.passedPeripheralType = scripting.forceWrite("Digital");
I2C1.sclPinConfig.$name                = "ti_driverlib_gpio_GPIOPinGeneric3";

I2C2.basicEnableController             = true;
I2C2.$name                             = "I2C_0";
I2C2.peripheral.$assign                = "I2C0";
I2C2.peripheral.sdaPin.$assign         = "boosterpack.34";
I2C2.peripheral.sclPin.$assign         = "boosterpack.33";
I2C2.sdaPinConfig.hideOutputInversion  = scripting.forceWrite(false);
I2C2.sdaPinConfig.onlyInternalResistor = scripting.forceWrite(false);
I2C2.sdaPinConfig.passedPeripheralType = scripting.forceWrite("Digital");
I2C2.sdaPinConfig.$name                = "ti_driverlib_gpio_GPIOPinGeneric6";
I2C2.sclPinConfig.hideOutputInversion  = scripting.forceWrite(false);
I2C2.sclPinConfig.onlyInternalResistor = scripting.forceWrite(false);
I2C2.sclPinConfig.passedPeripheralType = scripting.forceWrite("Digital");
I2C2.sclPinConfig.$name                = "ti_driverlib_gpio_GPIOPinGeneric7";

PWM1.$name                 = "PWM_0";
PWM1.timerCount            = 3200;
PWM1.PWM_CHANNEL_0.$name   = "ti_driverlib_pwm_PWMTimerCC0";
PWM1.PWM_CHANNEL_0.ccValue = 0;
PWM1.PWM_CHANNEL_1.$name   = "ti_driverlib_pwm_PWMTimerCC1";
PWM1.PWM_CHANNEL_1.ccValue = 0;
PWM1.ccp0PinConfig.$name   = "ti_driverlib_gpio_GPIOPinGeneric0";
PWM1.ccp1PinConfig.$name   = "ti_driverlib_gpio_GPIOPinGeneric1";

SYSCTL.MCLKSource      = "HSCLK";
SYSCTL.HSCLKSource     = "HFCLK";
SYSCTL.useHFCLK_Manual = true;
SYSCTL.HFCLKSource     = "HFXT";
SYSCTL.clockTreeEn     = true;
SYSCTL.SYSPLL_CLK2XEn  = true;

UART1.$name              = "UART_0";
UART1.targetBaudRate     = 115200;
UART1.peripheral.$assign = "UART2";
UART1.txPinConfig.$name  = "ti_driverlib_gpio_GPIOPinGeneric4";
UART1.rxPinConfig.$name  = "ti_driverlib_gpio_GPIOPinGeneric5";

UART2.$name                    = "UART_1";
UART2.peripheral.rxPin.$assign = "boosterpack.31";
UART2.peripheral.txPin.$assign = "j17_expansion.7";
UART2.txPinConfig.$name        = "ti_driverlib_gpio_GPIOPinGeneric8";
UART2.rxPinConfig.$name        = "ti_driverlib_gpio_GPIOPinGeneric9";

ProjectConfig.genLibIQVersion    = "MATHACL";
ProjectConfig.migrationCondition = true;

/**
 * Pinmux solution for unlocked pins/peripherals. This ensures that minor changes to the automatic solver in a future
 * version of the tool will not impact the pinmux you originally saw.  These lines can be completely deleted in order to
 * re-solve from scratch.
 */
GPIO1.associatedPins[0].pin.$suggestSolution = "boosterpack.9";
GPIO1.associatedPins[1].pin.$suggestSolution = "boosterpack.10";
GPIO2.associatedPins[0].pin.$suggestSolution = "boosterpack.37";
GPIO2.associatedPins[1].pin.$suggestSolution = "boosterpack.38";
GPIO2.associatedPins[2].pin.$suggestSolution = "boosterpack.3";
GPIO2.associatedPins[3].pin.$suggestSolution = "boosterpack.4";
GPIO4.associatedPins[0].pin.$suggestSolution = "boosterpack.30";
GPIO4.associatedPins[1].pin.$suggestSolution = "boosterpack.32";
GPIO4.associatedPins[2].pin.$suggestSolution = "boosterpack.7";
GPIO4.associatedPins[3].pin.$suggestSolution = "boosterpack.15";
GPIO5.associatedPins[0].pin.$suggestSolution = "boosterpack.27";
GPIO5.associatedPins[1].pin.$suggestSolution = "boosterpack.2";
GPIO5.associatedPins[2].pin.$suggestSolution = "boosterpack.5";
GPIO5.associatedPins[3].pin.$suggestSolution = "boosterpack.8";
PWM1.peripheral.$suggestSolution             = "TIMA0";
PWM1.peripheral.ccp0Pin.$suggestSolution     = "j19_expansion.9";
PWM1.peripheral.ccp1Pin.$suggestSolution     = "j17_expansion.9";
UART1.peripheral.rxPin.$suggestSolution      = "boosterpack.24";
UART1.peripheral.txPin.$suggestSolution      = "j17_expansion.8";
UART2.peripheral.$suggestSolution            = "UART3";
